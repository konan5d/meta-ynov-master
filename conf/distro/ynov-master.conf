## conf/distro/ynov-master.conf
```bitbake
require conf/distro/poky.conf

#Define name of distribution
DISTRO = "ynov-master"
DISTRO_NAME = "Ynov Master powered by Yocto/OE"

RPI_USE_U_BOOT = "1"
ENABLE_UART = "1"
ENABLE_I2C = "1"
ENABLE_SPI_BUS = "1"

VIRTUAL-RUNTIME_init_manager = "systemd"
DISTRO_FEATURES_BACKFILL_CONSIDERED = "sysvinit"
VIRTUAL-RUNTIME_initscripts = ""
DISTRO_FEATURES_append = " systemd"

# Append wifi distro
DISTRO_FEATURES_append = " wifi "
# To use wifi you need to modify the following file:
#   in systemd modif bbappend and add eth/en/wlan.network

#   create dir recipe-connectivity-> (file + wpa-supplicant_%.bbappend)
#      in file wpa-suplicant-nl80211wlan0.conf

# in image -> add distro in ynov-image-master

INHERIT += "rm_work_and_downloads"


KERNEL_MODULE_AUTOLOAD_rpi += "i2c-dev i2c-bcm2708"
```

## conf/layer.conf
```bitbake
# We have a conf and classes directory, add to BBPATH
BBPATH .= ":${LAYERDIR}"

# We have recipes-* directories, add to BBFILES
BBFILES += "${LAYERDIR}/recipes-*/*/*.bb \
            ${LAYERDIR}/recipes-*/*/*.bbappend"

BBFILE_COLLECTIONS += "meta-ynov-master"
BBFILE_PATTERN_meta-ynov-master = "^${LAYERDIR}/"
BBFILE_PRIORITY_meta-ynov-master = "6"

LAYERDEPENDS_meta-ynov-master = "core"
LAYERSERIES_COMPAT_meta-ynov-master = "gatesgarth"
```
